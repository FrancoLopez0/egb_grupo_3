/dts-v1/;
/plugin/;
/ {
	compatible = "brcm,bcm2712";
	fragment@0 {
		target = <&uart1>;
		__overlay__ {
			lux_control {
				compatible = "brightlight,lux_control";
				status = "okay";
			};
		};
	};
};
